## config/boards/shields/seagull/Kconfig.shield
```kconfig
config SHIELD_SEAGULL
    bool "Seagull Macropad"
    select ZMK_KSCAN_GPIO
    select ZMK_ENCODER
```

## config/boards/shields/void_ergo/Kconfig.defconfig
```kconfig
if SHIELD_ERGO_VOID_LEFT

    config ZMK_KEYBOARD_NAME
        default "Void Ergo"

    config ZMK_SPLIT_BLE_ROLE_CENTRAL
        default y
endif

if SHIELD_ERGO_VOID_LEFT || SHIELD_ERGO_VOID_RIGHT

    config ZMK_SPLIT
        default y

endif
```

## config/boards/shields/void_ergo/Kconfig.shield
```kconfig
config SHIELD_VOID_ERGO_LEFT
    def_bool $(shields_list_contains,void_ergo_left)

config SHIELD_VOID_ERGO_RIGHT
    def_bool $(shields_list_contains,void_ergo_right)
```
